## boards/arm/nrf52832_devboard/Kconfig.board
```kconfig
# Copyright (c) 2024 Nordic Semiconductor ASA
# SPDX-License-Identifier: Apache-2.0

config BOARD_NRF52832_DEVBOARD
	bool "nRF52832-Devboard"
	depends on SOC_NRF52832_QFAA
```

## boards/arm/nrf52832_devboard/Kconfig.defconfig
```kconfig
# Copyright (c) 2024 Nordic Semiconductor ASA
# SPDX-License-Identifier: Apache-2.0

if BOARD_NRF52832_DEVBOARD

config BOARD
	default "nrf52832_devboard"

config BT_CTLR
   default BT


endif
```
